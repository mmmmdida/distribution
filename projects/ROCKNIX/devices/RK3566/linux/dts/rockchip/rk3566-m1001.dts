#include "rk3566-powkiddy-x55.dts"

/ {
	model = "M1001";
	compatible = "powkiddy,m1001", "rockchip,rk3566";
};

/*
 * 背光：M1001 的 LCD_BL 控制脚是 GPIO3_C2，该引脚在 RK3566 上没有任何
 * PWM 复用功能（复用为 lcdc_d21 / spi1_miso_m1 / uart5_tx_m1 / i2s1m2_sdo3），
 * 因此改用 GPIO 开关型背光，默认点亮。
 */
&backlight {
	/delete-property/ pwms;
	/delete-property/ power-supply;
	compatible = "gpio-backlight";
	gpios = <&gpio3 RK_PC2 GPIO_ACTIVE_HIGH>;
	default-on;
};

/* FL7707N 720x720 2-lane MIPI-DSI 面板，RESX = GPIO3_C3 低有效 */
&panel {
	compatible = "fitipower,fl7707n";
	reset-gpios = <&gpio3 RK_PC3 GPIO_ACTIVE_LOW>;
	/delete-property/ iovcc-supply;
	/delete-property/ vcc-supply;
	/delete-property/ pinctrl-0;
	/delete-property/ pinctrl-names;
	rotation = <0>;
};

/*
 * M1001 的面板像素时钟要求 38MHz（812x791@59.16Hz）。
 * x55 原版把 VPLL 固定为 126.4MHz，VOP1 分频 /4 只得 31.6MHz，
 * 实际刷新仅 49.2Hz，面板无法同步。
 * 152MHz / 4 = 38MHz 精确整除。VPLL 只供 VOP1(dclk_vp1 / DSI) 使用，
 * VOP0(HDMI) 的 parent 是 HPLL，不受影响。
 */
&cru {
	assigned-clocks = <&pmucru CLK_RTC_32K>, <&cru PLL_GPLL>,
			  <&pmucru PLL_PPLL>, <&cru PLL_VPLL>;
	assigned-clock-rates = <32768>, <1200000000>,
			       <200000000>, <152000000>;
};

